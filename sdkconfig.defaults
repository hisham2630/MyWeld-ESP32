## sdkconfig.defaults
```kconfig
# MyWeld ESP32-S3 — ESP-IDF defaults
# Board: JC3248W535 (N16R8: 16MB flash, 8MB PSRAM OPI)

# --- Target ---
CONFIG_IDF_TARGET="esp32s3"

# --- Flash ---
CONFIG_ESPTOOLPY_FLASHSIZE_16MB=y
CONFIG_ESPTOOLPY_FLASHMODE_QIO=y
CONFIG_ESPTOOLPY_FLASHFREQ_80M=y

# --- PSRAM ---
CONFIG_SPIRAM=y
CONFIG_SPIRAM_MODE_OCT=y
CONFIG_SPIRAM_SPEED_80M=y
CONFIG_SPIRAM_BOOT_INIT=y
CONFIG_SPIRAM_MALLOC_ALWAYSINTERNAL=16384
# Do NOT enable SPIRAM_TRY_ALLOCATE_WIFI_LWIP — it competes with NimBLE internal RAM

# --- FreeRTOS ---
CONFIG_FREERTOS_HZ=1000
CONFIG_FREERTOS_UNICORE=n

# --- Bluetooth (NimBLE) ---
CONFIG_BT_ENABLED=y
CONFIG_BT_NIMBLE_ENABLED=y
CONFIG_BT_NIMBLE_MAX_CONNECTIONS=1
CONFIG_BT_NIMBLE_ROLE_CENTRAL=n
CONFIG_BT_NIMBLE_ROLE_OBSERVER=n
CONFIG_BT_NIMBLE_ROLE_BROADCASTER=n
CONFIG_BT_NIMBLE_ROLE_PERIPHERAL=y
CONFIG_BT_NIMBLE_HOST_TASK_STACK_SIZE=8192
# Allow NimBLE to use default heap (which can go to PSRAM on this board).
# INTERNAL-only mode exhausts the ~170KB internal RAM when LVGL framebuffer
# + BLE host stack are both active, causing nimble_port_init() to fail
# → no advertising → phone never sees "MyWeld".
CONFIG_BT_NIMBLE_MEM_ALLOC_MODE_DEFAULT=y

# --- I2S ---
CONFIG_SOC_I2S_SUPPORTED=y

# --- Log Level ---
CONFIG_LOG_DEFAULT_LEVEL_INFO=y

# --- Partition Table ---
CONFIG_PARTITION_TABLE_CUSTOM=y
CONFIG_PARTITION_TABLE_CUSTOM_FILENAME="partitions.csv"

# --- Watchdog ---
CONFIG_ESP_TASK_WDT_TIMEOUT_S=10

# --- LVGL ---
# Handled via lv_conf.h, no Kconfig needed
```

## sdkconfig.defaults.jc4827w543
```kconfig
# MyWeld ESP32-S3 — JC4827W543 overrides (4MB flash)
# This file is applied AFTER sdkconfig.defaults to override flash-specific settings.

# --- Flash (4MB instead of 16MB) ---
# CONFIG_ESPTOOLPY_FLASHSIZE_16MB is not set
CONFIG_ESPTOOLPY_FLASHSIZE_4MB=y
CONFIG_ESPTOOLPY_FLASHSIZE="4MB"

# --- Partition Table (4MB OTA layout) ---
CONFIG_PARTITION_TABLE_CUSTOM=y
CONFIG_PARTITION_TABLE_CUSTOM_FILENAME="partitions_4mb.csv"

# --- PSRAM (same OPI PSRAM, 2MB on this board) ---
CONFIG_SPIRAM=y
CONFIG_SPIRAM_MODE_OCT=y
CONFIG_SPIRAM_SPEED_80M=y
```
